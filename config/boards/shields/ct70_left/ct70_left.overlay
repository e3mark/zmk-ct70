&matrix {
    row-gpios = <&gpio0 3 GPIO_ACTIVE_LOW>, <&gpio0 4 GPIO_ACTIVE_LOW>,
                 <&gpio0 5 GPIO_ACTIVE_LOW>, <&gpio0 6 GPIO_ACTIVE_LOW>,
                 <&gpio0 7 GPIO_ACTIVE_LOW>;

    col-gpios = <&gpio0 21 GPIO_ACTIVE_LOW>, <&gpio0 22 GPIO_ACTIVE_LOW>,
                 <&gpio0 19 GPIO_ACTIVE_LOW>, <&gpio0 18 GPIO_ACTIVE_LOW>,
                 <&gpio0 15 GPIO_ACTIVE_LOW>, <&gpio0 14 GPIO_ACTIVE_LOW>,
                 <&gpio0 16 GPIO_ACTIVE_LOW>;

    diode-direction = <COL2ROW>;
};
