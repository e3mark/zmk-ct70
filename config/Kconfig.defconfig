## config/Kconfig.defconfig
```kconfig
if SHIELD_CT70_LEFT

config ZMK_KEYBOARD_NAME
    default "CT70"

config ZMK_SPLIT_ROLE_CENTRAL
    default y

endif

if SHIELD_CT70_LEFT || SHIELD_CT70_RIGHT

config ZMK_SPLIT
    default y

endif
```

## config/boards/shields/ct70/Kconfig.shield
```kconfig
config SHIELD_CT70_LEFT
    def_bool $(shields_list_contains,ct70_left)

config SHIELD_CT70_RIGHT
    def_bool $(shields_list_contains,ct70_right)
```
